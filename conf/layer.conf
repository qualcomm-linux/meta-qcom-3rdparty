## conf/machine/uno-q.conf
```bitbake
#@TYPE: Machine
#@NAME: Arduino UNO Q
#@DESCRIPTION: Machine configuration for Arduino UNO Q

MACHINEOVERRIDES =. "arduino:"

PREFERRED_PROVIDER_virtual/kernel ?= "linux-arduino"

require conf/machine/include/qcom-qcm2290.inc

MACHINE_FEATURES = "efi usbhost usbgadget alsa wifi bluetooth"

UBOOT_CONFIG = "qrb2210-arduino-imola"
UBOOT_CONFIG[qrb2210-arduino-imola] = "qcom_defconfig"
UBOOT_INITIAL_ENV = ""

QCOM_DTB_DEFAULT ?= "qrb2210-arduino-imola"

KERNEL_DEVICETREE ?= " \
                      qcom/qrb2210-arduino-imola.dtb \
                      "

KERNEL_CMDLINE_EXTRA += "deferred_probe_timeout=30"

MACHINE_ESSENTIAL_EXTRA_RRECOMMENDS += " \
    packagegroup-uno-q-firmware \
    packagegroup-uno-q-hexagon-dsp-binaries \
    packagegroup-uno-q-kernel-modules \
"

QCOM_CDT_FILE = "cdt_arduino_imola"
QCOM_BOOT_FILES_SUBDIR = "qrb2210"
QCOM_PARTITION_FILES_SUBDIR ?= "partitions/qrb2210-unoq/emmc-16GB"

QCOM_BOOT_FIRMWARE = "firmware-qcom-boot-qrb2210"
QCOM_CDT_FIRMWARE = "firmware-qcom-cdt-uno-q"
```
