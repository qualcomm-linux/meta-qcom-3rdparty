## conf/machine/qcs6490-thundercomm-rubikpi3.conf
```bitbake
#@TYPE: Machine
#@NAME: Thundercomm RUBIK Pi 3 (QCS6490)
#@DESCRIPTION: Machine configuration for Thundercomm RUBIK Pi 3, with QCS6490.
#
# Boot architecture (upstream Qualcomm Linux conventions):
#
#   PBL                                  (in-SoC ROM, immutable)
#     -> XBL                             UFS LUN 1 'xbl_a'   (from boot-assets)
#       -> UEFI                          UFS LUN 4 'uefi_a'  (from boot-assets)
#         -> systemd-boot UKI            UFS LUN 0 'efi'     (esp-qcom-image, this build)
#           -> kernel + dtb              UFS LUN 4 'dtb_a' VFAT containing combined-dtb.dtb
#             -> rootfs ext4             UFS LUN 0 'rootfs'  (this build)
#
# All Qualcomm-signed boot firmware (XBL, UEFI, TZ, HYP, AOP, devcfg, qupv3fw,
# cpucp, etc.) plus the Rubik Pi 3-specific LUN 6 payloads (rubikpi_config,
# devcfg_full, rubikpi_dtso) and the matching partition layout XMLs for LUNs
# 1-6 come from rubikpi-ai/boot-assets via firmware-qcom-boot-rubikpi3.bb.
# LUN 0 uses a Yocto-friendly efi + rootfs layout shipped by the same recipe.
# Kernel, dtb and rootfs are built here.

require conf/machine/include/qcom-qcs6490.inc

MACHINE_FEATURES += "efi pci"

# Tolerate i2c/probe-order race that intermittently makes msm-mdss give up
# waiting for the lt9611 HDMI bridge (bound at ~17-18s) and never bring up
# /dev/dri/card0. Default deferred_probe_timeout is too tight on this board.
KERNEL_CMDLINE_EXTRA:append = " deferred_probe_timeout=30"

# ---------------------------------------------------------------------------
# Kernel / Device Tree
# ---------------------------------------------------------------------------
KERNEL_DEVICETREE = "qcom/qcs6490-thundercomm-rubikpi3.dtb"

PREFERRED_PROVIDER_virtual/kernel ?= "linux-qcom-next"

QCOM_DTB_DEFAULT ?= "qcs6490-thundercomm-rubikpi3"

# ---------------------------------------------------------------------------
# Boot firmware: rubikpi3-specific recipe pulling from rubikpi-ai/boot-assets.
# Same pattern as Arduino UNO Q's firmware-qcom-boot-qrb2210-arduino-imola.
# ---------------------------------------------------------------------------
QCOM_BOOT_FIRMWARE = "firmware-qcom-boot-rubikpi3"
QCOM_BOOT_FILES_SUBDIR = "rubikpi3"

# Partition layout: generated by qcom-ptool from
# platforms/qcs6490-thundercomm-rubikpi3/ufs in github.com/qualcomm-linux/qcom-ptool
# and deployed by qcom-partition-conf in meta-qcom.
QCOM_PARTITION_FILES_SUBDIR ?= "partitions/qcs6490-thundercomm-rubikpi3/ufs"

# Board CDT file (basename, no extension) — installed by firmware-qcom-boot-rubikpi3.
QCOM_CDT_FILE = "RubikPi3_CDT"

# Bootloader: upstream Qualcomm UEFI from boot-assets; no U-Boot.

# QCOM_BOOTIMG_ROOTFS defaults to "PARTLABEL=rootfs" in qcom-base.inc, which
# matches our LUN 0 layout — no override needed here.

# ---------------------------------------------------------------------------
# Firmware packages installed into rootfs.
# ---------------------------------------------------------------------------
MACHINE_ESSENTIAL_EXTRA_RRECOMMENDS += " \
    packagegroup-qcom-boot-essential \
    packagegroup-machine-essential-qcom-qcs6490-soc \
    packagegroup-qcs6490-thundercomm-rubikpi3-firmware \
"
```

## conf/machine/radxa-dragon-q6a.conf
```bitbake
#@TYPE: Machine
#@NAME: Radxa Dragon Q6A
#@DESCRIPTION: Machine configuration for Radxa Dragon Q6A, with QCS6490
#
# Boot architecture:
#   SPI NOR (Radxa-managed):  PBL -> XBL -> UEFI/EDK2 -> discovers ESP
#   SD/UFS/NVMe (Yocto-built): ESP (systemd-boot + UKI) + rootfs
#
# SPI NOR firmware is flashed separately via Radxa's edl-ng package.
# This machine conf only produces the OS disk image (ESP + rootfs).

require conf/machine/include/qcom-qcs6490.inc

MACHINE_FEATURES += "efi pci"

# ---------------------------------------------------------------------------
# Kernel / Device Tree
# ---------------------------------------------------------------------------
KERNEL_DEVICETREE = "qcom/qcs6490-radxa-dragon-q6a.dtb"

PREFERRED_PROVIDER_virtual/kernel ?= "linux-qcom-next"

# ---------------------------------------------------------------------------
# Boot firmware: NOT managed by Yocto
# ---------------------------------------------------------------------------
# SPI NOR contents (XBL, UEFI, TZ, HYP, DEVCFG, AOP, CDT) are provided
# by Radxa and flashed independently. Blank these out so the qcomflash
# class doesn't try to package or depend on Qualcomm boot firmware.
QCOM_BOOT_FIRMWARE = ""
QCOM_BOOT_FILES_SUBDIR = ""
QCOM_PARTITION_FILES_SUBDIR = ""
QCOM_PARTITION_FILES_SUBDIR_SPINOR = ""
QCOM_PARTITION_CONF = ""
QCOM_CDT_FILE = ""

# ---------------------------------------------------------------------------
# Bootloader: Radxa EDK2 in SPI NOR — no U-Boot needed
# ---------------------------------------------------------------------------
# Do NOT set PREFERRED_PROVIDER_virtual/bootloader.
# The qcomflash class defaults to uefi.elf from QCOM_BOOT_FILES_SUBDIR,
# which is empty, so it's a no-op.

# ---------------------------------------------------------------------------
# EFI System Partition + UKI boot
# ---------------------------------------------------------------------------
# Use the canned UEFI UKI WKS — it creates the ESP inline via the
# bootimg_efi plugin (systemd-boot + UKI) with correct GPT type GUID.
# No need for the standalone esp-qcom-image recipe.
WKS_FILE = "efi-uki-bootdisk.wks.in"
QCOM_ESP_IMAGE = ""

# SD card uses 512-byte sectors; override to 4096 for UFS targets
QCOM_VFAT_SECTOR_SIZE ?= "512"

# Root device identifier for the UKI kernel cmdline
QCOM_BOOTIMG_ROOTFS ?= "PARTLABEL=root"
QCOM_DTB_DEFAULT ?= "qcs6490-radxa-dragon-q6a"
# ---------------------------------------------------------------------------
# Image output
# ---------------------------------------------------------------------------
IMAGE_FSTYPES += "wic wic.gz wic.bmap"

# ---------------------------------------------------------------------------
# Firmware packages
# ---------------------------------------------------------------------------
MACHINE_ESSENTIAL_EXTRA_RRECOMMENDS += " \
    packagegroup-qcom-boot-essential \
    packagegroup-machine-essential-qcom-qcs6490-soc \
    packagegroup-radxa-dragon-q6a-firmware \
    packagegroup-radxa-dragon-q6a-hexagon-dsp-binaries \
    qairt-sdk-hexagon-v68 \
"
```

## conf/machine/ventuno-q.conf
```bitbake
#@TYPE: Machine
#@NAME: Arduino VENTUNO Q
#@DESCRIPTION: Machine configuration for Arduino VENTUNO Q

PREFERRED_PROVIDER_virtual/kernel ?= "linux-qcom-next"

require conf/machine/include/qcom-qcs8300.inc

MACHINE_FEATURES += "efi pci tpm2 alsa wifi bluetooth"

QCOM_DTB_DEFAULT ?= "monaco-arduino-monza"

KERNEL_DEVICETREE ?= " \
                      qcom/monaco-arduino-monza.dtb \
                      "

MACHINE_ESSENTIAL_EXTRA_RRECOMMENDS += " \
    packagegroup-ventuno-q-firmware \
    packagegroup-ventuno-q-hexagon-dsp-binaries \
    qairt-sdk-hexagon-v75 \
    qcom-fastcv-binaries-qcs8300-ride-dsp \
"

QCOM_CDT_FILE = "cdt_qcs8275-Monza"
QCOM_BOOT_FILES_SUBDIR = "qcs8275-arduino-monza"
QCOM_PARTITION_FILES_SUBDIR ?= "partitions/qcs8275-monza/emmc"

QCOM_BOOT_FIRMWARE = "firmware-qcom-boot-qcs8275-arduino-monza"
```
